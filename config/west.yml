## config/west.yml
```yaml
manifest:
  remotes:
    - name: BarbUk
      url-base: https://github.com/BarbUk
  projects:
    - name: zmk
      remote: BarbUk
      revision: m60
      import: app/west.yml
  self:
    path: config
```
